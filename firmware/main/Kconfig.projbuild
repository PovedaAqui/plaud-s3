## firmware/main/Kconfig.projbuild
```kconfig
menu "Plaud-S3 recorder"

    config PLAUD_WIFI_SSID
        string "Wi-Fi SSID"
        default ""
        help
            Network the recorder joins at boot. 2.4 GHz only (the ESP32-S3 has no 5 GHz radio).

    config PLAUD_WIFI_PASSWORD
        string "Wi-Fi password"
        default ""

    config PLAUD_SERVER_URL
        string "Ingest WebSocket URL"
        default ""
        help
            Host running server/app/main.py, for example ws://192.168.1.50:8000/ws/audio.
            Leave empty to record offline only; uploads start once a URL is configured.

    config PLAUD_UPLOAD_RETRY_S
        int "Seconds between upload attempts"
        range 1 120
        default 5

    config PLAUD_LONG_PRESS_MS
        int "Long-press threshold for stop (ms)"
        range 400 5000
        default 1500

    config PLAUD_BRIGHTNESS
        int "Normal screen brightness (%)"
        range 10 100
        default 80

    config PLAUD_SCREENSAVER_S
        int "Idle seconds before the pocket-watch screensaver"
        range 0 3600
        default 30
        help
            0 disables the screensaver. While it is shown the first tap only wakes
            the device, so a brush against the screen cannot start a recording.

    config PLAUD_DIM_BRIGHTNESS
        int "Screensaver brightness (%)"
        range 1 100
        default 25


    config PLAUD_NTP_SERVER
        string "NTP server"
        default "pool.ntp.org"

    config PLAUD_DEVICE_NAME
        string "Device name reported to the server"
        default "plaud-s3"

    config PLAUD_AUTOTEST_SECONDS
        int "Record automatically for N seconds after boot (0 = off)"
        range 0 300
        default 0
        help
            Smoke-test hook: starts a recording as soon as Wi-Fi is up and stops
            after N seconds. Leave at 0 for normal use.

    config PLAUD_SD_ENABLE
        bool "Mount a microSD card when one is wired"
        default n
        help
            Tries SDMMC 1-bit at boot and, if a card answers, records new audio
            there instead of the internal 16 MB partition. Pending files on the
            internal partition are still uploaded. Leave off until the card
            slot pins below match real hardware: driving the wrong pins can
            disturb the display and I2C bus.

    config PLAUD_SD_CLK
        int "microSD CLK GPIO"
        depends on PLAUD_SD_ENABLE
        default 39

    config PLAUD_SD_CMD
        int "microSD CMD GPIO"
        depends on PLAUD_SD_ENABLE
        default 38

    config PLAUD_SD_D0
        int "microSD D0 GPIO"
        depends on PLAUD_SD_ENABLE
        default 40

    config PLAUD_SD_FREQ_KHZ
        int "microSD clock (kHz)"
        depends on PLAUD_SD_ENABLE
        default 20000

    config PLAUD_CHANNELS
        int "Microphone channels read from the codec"
        range 1 2
        default 2
        help
            The board has two digital microphones behind the ES7210 ADC. Stereo is
            downmixed to mono on the device before streaming.

endmenu
```
